## drivers/dma/Kconfig.hpmicro
```kconfig
# Copyright (c) 2026 Cody Gu <gujiaqi@iscas.ac.cn>
# SPDX-License-Identifier: Apache-2.0

DT_COMPAT_HPM_DMA := hpmicro,hpm-dma

config DMA_HPMICRO
	bool "HPMicro DMAV2 and DMAMUX driver"
	default y
	depends on DMA
	depends on !DMA_64BIT
	depends on CLOCK_CONTROL
	depends on DT_HAS_HPMICRO_HPM_DMA_ENABLED
	depends on HAS_HPMSDK_DMAV2
	depends on HAS_HPMSDK_DMAMUX
	select USE_HPMSDK_DMAV2
	help
	  Enable the HPMicro DMAV2 controller with its channel-coupled DMAMUX.
	  Memory-to-memory, memory-to-peripheral and peripheral-to-memory
	  transfers are supported.
```

## drivers/serial/Kconfig.hpmicro
```kconfig
# Copyright (c) 2024 HPMicro
# Copyright (c) 2026 Cody Gu <gujiaqi@iscas.ac.cn>
# SPDX-License-Identifier: Apache-2.0

config UART_HPMICRO
	bool "HPMicro UART driver"
	default y
	depends on DT_HAS_HPMICRO_HPM_UART_ENABLED
	depends on CLOCK_CONTROL
	depends on HAS_HPMSDK_UART
	select PINCTRL
	select SERIAL_HAS_DRIVER
	select SERIAL_SUPPORT_INTERRUPT
	select USE_HPMSDK_UART
	help
	  Enable the UART driver for HPMicro UART controllers. Polling is
	  always available, and interrupt-driven operation can be enabled
	  with CONFIG_UART_INTERRUPT_DRIVEN.
```

## dts/bindings/dma/hpmicro,hpm-dma.yaml
```yaml
# Copyright (c) 2026 Cody Gu <gujiaqi@iscas.ac.cn>
# SPDX-License-Identifier: Apache-2.0

description: |
  HPMicro DMAV2 controller with channel-coupled DMAMUX.

  Each DMA channel has a matching DMAMUX channel. Client DMA specifiers use
  two cells: the DMA channel and the DMAMUX request source. The request source
  is ignored for memory-to-memory transfers.

compatible: "hpmicro,hpm-dma"

include: dma-controller.yaml

properties:
  reg:
    required: true
    description: |
      DMAV2 register block followed by the DMAMUX register block.

  reg-names:
    required: true

  interrupts:
    required: true

  clocks:
    required: true
    description: |
      Clock specifier with the HPM clock resource, source selector and
      divider, respectively.

  clock-names:
    required: true

  dma-channels:
    required: true

  dma-requests:
    required: true
    description: Number of valid DMAMUX request source identifiers.

  "#dma-cells":
    const: 2

dma-cells:
  - channel
  - request
```
